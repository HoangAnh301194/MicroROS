## src/Kconfig.projbuild
```kconfig
menu "micro-ROS demo task settings"
    config MICRO_ROS_APP_STACK
        int "Stack size (bytes) for micro-ROS task"
        range 8192 32768
        default 16000

    config MICRO_ROS_APP_TASK_PRIO
        int "FreeRTOS priority for micro-ROS task"
        range 1 24
        default 5
endmenu
```
